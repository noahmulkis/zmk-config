## boards/shields/KillerKeys/Kconfig.defconfig
```kconfig
if SHIELD_KILLERKEYS_LEFT || SHIELD_KILLERKEYS_RIGHT

config ZMK_KEYBOARD_NAME
    default "KillerKeys"

endif
```

## boards/shields/KillerKeys/Kconfig.shield
```kconfig
config SHIELD_KILLERKEYS_LEFT
    def_bool $(shields_list_contains,killerkeys_left)

config SHIELD_KILLERKEYS_RIGHT
    def_bool $(shields_list_contains,killerkeys_right)
```
